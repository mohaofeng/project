   

#define ST7588_C


#include "absacc.h"
#include "st7588.h"
#include "delay.h"
#include "font.h"
#include "pic.h"
#include "common.h"

//extern __Sys_Var SysVar;
extern __ConfigVar Config;								//系统配置参数





volatile uint8_t LCDRam[140][70]={
{0x00,0x00,0x00,0x00,0x00,0x00,0x00,0x00,0x00,0x00},
{0x00,0x00,0x00,0x00,0x00,0x00,0x00,0x00,0x00,0x00},
{0x00,0x00,0x00,0x00,0x00,0x00,0x00,0x00,0x00,0x00},
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{0x00,0x00,0x00,0x00,0x00,0x00,0x00,0x00,0x00,0x00}};


//***************************************************************************SPI4-B 
void Write_ST7588_COM(uint8_t COMDADA_4SPI)
{
	uint8_t bit8;
	A0=0;
	CS0=0;
	for(bit8=0;bit8<8;bit8++)
	{
		SCL=0;
		if((COMDADA_4SPI&0x80)==0x80)
			SDI=1;
		else		
			SDI=0;
		SCL=1;
		COMDADA_4SPI=(COMDADA_4SPI<<1);
	}
    CS0=1;
}

void Write_ST7588_DISPLAY_DATA_serial_4SPI(uint8_t DADA_4SPI)
{   
	uint8_t bit8;
	A0=1;
	CS0=0;				
	for(bit8=0;bit8<8;bit8++)
	{
		SCL=0;
		if((DADA_4SPI&0x80)==0x80)
			SDI=1;
		else
			SDI=0;
		SCL=1;
		DADA_4SPI=(DADA_4SPI<<1);
	}
	CS0=1;
}

void HDReset(void)
{
	RSTB=0;
	delay_ms(2);
	RSTB=1;
	delay_ms(2);
}

//更新显存到LCD		 
void LCDRefresh_Gram(void)
{
	uint8_t i,n;		    
	for(i=0;i<10;i++)
	{  
		if(Config.disdir)
			Write_ST7588_COM(FUNC_SET|MIRROR_X|MIRROR_Y);	  //function set//h1=h0=0  38
		else
			Write_ST7588_COM(FUNC_SET&(~(MIRROR_X|MIRROR_Y)));	  //function set//h1=h0=0  38
		Write_ST7588_COM(SET_YADDR+i);	 //SET PAGE 0---9
	  Write_ST7588_COM(SET_XADDL);	 //SET COLUMN LSB
		Write_ST7588_COM(SET_XADDH);	  //SET CLUMN MSB
		for(n=0;n<132;n++)
		{
			Write_ST7588_DISPLAY_DATA_serial_4SPI(LCDRam[n][i]);
		}
	}   
}

//开启OLED显示    
void LCD_Display_On(void)
{
	Write_ST7588_COM(FUNC_SET);	  							//function set//h1=h0=0	   	   
	Write_ST7588_COM(DISPLAY_CTRL|NORMAL_DIS);	
}
//关闭OLED显示     
void LCD_Display_Off(void)
{
	Write_ST7588_COM(FUNC_SET);	  							//function set//h1=h0=0	   	   
	Write_ST7588_COM(DISPLAY_CTRL|ALL_SEGOFF);	   				
}		   			 

//--------------------------------------------------------------------------


//清屏函数,清完屏,整个屏幕是黑色的!和没点亮一样!!!	  
void LCD_Clear(void)  
{  
	uint8_t i,n;  
	for(i=0;i<10;i++)
		for(n=0;n<132;n++)
			LCDRam[n][i]=0X00; 
}

// //画点 
// //x:0~127
// //y:0~63
// //t:1 填充 0,清空				   
void LCD_DrawPoint(uint8_t x,uint8_t y,uint8_t t)
{
	uint8_t pos,bx,temp=0;
	if(x>=131||y>=77)return;//超出范围了.
	x +=4;
	pos=y/8;
	bx=y%8;
	temp=(0x80>>bx);
	if(t)
	{
		LCDRam[x][pos] |= temp;
	}
	else
	{
		LCDRam[x][pos] &= ~temp;	
	}    
}

//x1,y1,x2,y2 填充区域的对角坐标
//确保x1<=x2;y1<=y2 0<=x1<=127 0<=y1<=63	 	 
//dot:0,清空;1,填充	  
void LCD_Fill(uint8_t x1,uint8_t y1,uint8_t x2,uint8_t y2,uint8_t dot)  
{  
	uint8_t x,y;  
	for(x=x1;x<=x2;x++)
	{
		for(y=y1;y<=y2;y++)LCD_DrawPoint(x,y,dot);
	}													    
	LCDRefresh_Gram();//更新显示
}
//在指定位置显示一个字符,包括部分字符
//x:0~127
//y:0~63
//mode:0,反白显示;1,正常显示				 
//size:选择字体 16/12 
void LCD_ShowChar(uint8_t x,uint8_t y,uint8_t chr,uint8_t size,uint8_t mode)
{      			    
	uint8_t temp,t,t1;
	uint8_t y0=y;
	chr=chr-' ';//得到偏移后的值				   
	for(t=0;t<size;t++)
	{   
		if(size==12)
			temp=LCD_asc2_1206[chr][t];  //调用1206字体
		else 
			temp=LCD_asc2_1608[chr][t];		 //调用1608字体 	                          
		for(t1=0;t1<8;t1++)
		{
			if(temp&0x80)
				LCD_DrawPoint(x,y,mode);
			else 
				LCD_DrawPoint(x,y,!mode);
			temp<<=1;
			y++;
			if((y-y0)==size)
			{
				y=y0;
				x++;
				break;
			}
		}  	 
	}          
}
//m^n函数
u32 LCD_pow(uint8_t m,uint8_t n)
{
	u32 result=1;	 
	while(n--)result*=m;    
	return result;
}				  
//显示2个数字
//x,y :起点坐标	 
//len :数字的位数
//size:字体大小
//mode:模式	0,填充模式;1,叠加模式
//num:数值(0~4294967295);	 		  
void LCD_ShowNum(uint8_t x,uint8_t y,u32 num,uint8_t len,uint8_t size)
{         	
	uint8_t t,temp;
	uint8_t enshow=0;						   
	for(t=0;t<len;t++)
	{
		temp=(num/LCD_pow(10,len-t-1))%10;
		if(enshow==0&&t<(len-1))
		{
			if(temp==0)
			{
				LCD_ShowChar(x+(size/2)*t,y,'0',size,1);
				continue;
			}else enshow=1; 
		 	 
		}
	 	LCD_ShowChar(x+(size/2)*t,y,temp+'0',size,1); 
	}
} 


//显示数字,高位为0,还是显示
//x,y:起点坐标
//num:数值(0~999999999);	 
//len:长度(即要显示的位数)
//size:字体大小
//mode:
//[7]:0,不填充;1,填充0.
//[6:1]:保留
//[0]:0,非叠加显示;1,叠加显示.
void LCD_ShowxNum(u16 x,u16 y,u32 num,u8 len,u8 size,u8 mode)
{  
	u8 t,temp;
	u8 enshow=0;						   
	for(t=0;t<len;t++)
	{
		temp=(num/LCD_pow(10,len-t-1))%10;
		if(enshow==0&&t<(len-1))
		{
			if(temp==0)
			{
				if(mode&0X80)LCD_ShowChar(x+(size/2)*t,y,'0',size,mode&0X01);  
				else LCD_ShowChar(x+(size/2)*t,y,' ',size,mode&0X01);  
 				continue;
			}else enshow=1; 
		 	 
		}
	 	LCD_ShowChar(x+(size/2)*t,y,temp+'0',size,mode&0X01); 
	}
} 

//显示字符串
//x,y:起点坐标  
//*p:字符串起始地址
//用16字体
void LCD_ShowString(uint8_t x,uint8_t y,const uint8_t *p)
{
#define MAX_CHAR_POSX 131
#define MAX_CHAR_POSY 77          
    while(*p!='\0')
    {       
        if(x>MAX_CHAR_POSX){x=0;y+=12;}
        if(y>MAX_CHAR_POSY){y=x=0;LCD_Clear();}
        LCD_ShowChar(x,y,*p,12,1);	 
        x+=8;
        p++;
    }  
}	   

//画线
//x1,y1:起点坐标
//x2,y2:终点坐标  
void LCD_DrawLine(uint8_t x1, uint8_t y1, uint8_t x2, uint8_t y2)
{//LCD_DrawPoint();
	uint8_t t; 
	uint8_t xerr=0,yerr=0,delta_x,delta_y,distance; 
	uint8_t incx,incy,uRow,uCol; 
	delta_x=x2-x1; 							//计算坐标增量 
	delta_y=y2-y1; 
	uRow=x1; 
	uCol=y1; 
	if(delta_x>0)
	{
		incx=1; //设置单步方向 
	}
	else if(delta_x==0)
	{
		incx=0;//垂直线 
	}
	if(delta_y>0)
		incy=1; 
	else if(delta_y==0)
	{
		incy=0;//水平线
	}			
	if( delta_x>delta_y)
		distance=delta_x; //选取基本增量坐标轴 
	else {
		distance=delta_y; 
	}
	for(t=0;t<=distance+1;t++ ){//画线输出 
		LCD_DrawPoint(uRow,uCol,1);//画点 
		xerr+=delta_x ; 
		yerr+=delta_y ; 
		if(xerr>distance) { 
			xerr-=distance; 
			uRow+=incx; 
		} 
		if(yerr>distance) { 
			yerr-=distance; 
			uCol+=incy; 
		} 
	}  
}    

//画矩形	  
//(x1,y1),(x2,y2):矩形的对角坐标
void LCD_DrawRectangle(uint8_t x1, uint8_t y1, uint8_t x2, uint8_t y2)
{
	LCD_DrawLine(x1,y1,x2,y1);
	LCD_DrawLine(x1,y1,x1,y2);
	LCD_DrawLine(x1,y2,x2,y2);
	LCD_DrawLine(x2,y1,x2,y2);
}
//在指定位置画一个指定大小的圆
//(x,y):中心点
//r    :半径
void Draw_Circle(uint8_t x0,uint8_t y0,uint8_t r)
{
	int a,b;
	int di;
	a=0;b=r;	  
	di=3-(r<<1);             //判断下个点位置的标志
	while(a<=b)
	{
		LCD_DrawPoint(x0+a,y0-b,1);             //5
 		LCD_DrawPoint(x0+b,y0-a,1);             //0           
		LCD_DrawPoint(x0+b,y0+a,1);             //4               
		LCD_DrawPoint(x0+a,y0+b,1);             //6 
		LCD_DrawPoint(x0-a,y0+b,1);             //1       
 		LCD_DrawPoint(x0-b,y0+a,1);             
		LCD_DrawPoint(x0-a,y0-b,1);             //2             
  		LCD_DrawPoint(x0-b,y0-a,1);             //7     	         
		a++;
		//使用Bresenham算法画圆     
		if(di<0)di +=4*a+6;	  
		else
		{
			di+=10+4*(a-b);   
			b--;
		} 						    
	}
} 									  


void Init_ST7588(void)
{
	HDReset();
	delay_ms(10);
	
	
	Write_ST7588_COM(FUNC_SET|H0|H1);	  	//function set//h1=h0=1
	Write_ST7588_COM(LCD_BIAS|BIAS_10);	   									//bias system //	 0x10 1/11,0x11 1/10,0x12 1/9
//	Write_ST7588_COM(SOFT_RST);	  //soft reset
	Write_ST7588_COM(FUNC_SET);	  				//function set//h1=h0=0	   	   
	Write_ST7588_COM(VOP_RANGE|PRS_H);	   									//set vo range//05表示高压，04表示低压
	Write_ST7588_COM(DISPLAY_CTRL|INVERSE_DIS);	   					// All display segments on
	Write_ST7588_COM(FUNC_SET|H0);	   		//function set//h1=0，h0=1
	Write_ST7588_COM(DISPLAY_CFG|LSB_TOP);	   											//display configulation//d0=0,v=0	   	   
	Write_ST7588_COM(0x9F);	   															// set v0  对比度电压调节 最低是0x80，最高是0xff,值越大，对比度越高	
	LCD_Clear();
}

 void Display_pic(uint8_t x,uint8_t y,uint8_t with,uint8_t hight,uint8_t mode)
 {      			    
	 uint8_t temp,t1;
	 uint16_t t;
	 uint8_t y0=y;
	 uint8_t high0;
	 high0 = hight/8;
	 for(t=0;t<with*high0;t++)
	 {   
			temp=gImage_logo[t];		 //调用1608字体 	                          
		for(t1=0;t1<8;t1++)
		{
			if(temp&0x01)
				LCD_DrawPoint(x,y,mode);
			else 
				LCD_DrawPoint(x,y,!mode);
			temp>>=1;
			y++;
			if((y-y0)==hight)
			{
				y=y0;
				x++;
				break;
			}
		}  	 
	}          
}
 void Displayxiaoji(uint8_t x,uint8_t y,uint8_t with,uint8_t hight,uint8_t mode)
 {      			    
	 uint8_t temp,t1;
	 uint16_t t;
	 uint8_t y0=y;
	 uint8_t high0;
	 high0 = hight/8;
	 for(t=0;t<with*high0;t++)
	 {   
			temp=gImageEye[t];		 //调用1608字体 	                          
		 for(t1=0;t1<8;t1++)
		 {
			if(temp&0x01)
				LCD_DrawPoint(x,y,mode);
			else 
				LCD_DrawPoint(x,y,!mode);
			temp>>=1;
			y++;
			if((y-y0)==hight)
			{
				y=y0;
				x++;
				break;
			}
		}  	 
	}          
}

 void DisplayOneEye(uint8_t x,uint8_t y,uint8_t with,uint8_t hight,uint8_t mode)
 {      			    
	uint8_t temp,t1;
	 uint16_t t;
	uint8_t y0=y;
	 uint8_t high0;
	 high0 = hight/8;
	 for(t=0;t<with*high0;t++)
	 {   
			temp=gOneEye[t];		 //调用1608字体 	                          
		 for(t1=0;t1<8;t1++)
		 {
			if(temp&0x01)
				LCD_DrawPoint(x,y,mode);
			else 
				LCD_DrawPoint(x,y,!mode);
			temp>>=1;
			y++;
			if((y-y0)==hight)
			{
				y=y0;
				x++;
				break;
			}
		}  	 
	}          
}



 void LCD_Showhz(uint8_t x,uint8_t y,uint8_t hro,uint8_t size,uint8_t mode)
 {      			    
	uint8_t temp=0;
	uint8_t t=0;
	uint8_t t1=0;
	uint8_t t2=0;
	uint8_t y0=y;
	if(size == 16)
		t2 = 2;
	if(size == 32)
		t2 = 4;
	for(t=0;t<(size*t2);t++)
	{
 		if(size == 16)
		{
			temp=LCD_hz_1616[hro][t];		 //调用1608字体 
		}		
		else
		{
			temp=LCD_hz_3232[hro][t];		 //调用1608字体
		}
		for(t1=0;t1<8;t1++)
		{
			if(temp&0x01)
				LCD_DrawPoint(x,y,mode);
			else 
				LCD_DrawPoint(x,y,!mode);
			temp>>=1;
			y++;
			if((y-y0)==size)
			{
				y=y0;
				x++;
//				break;
			}
		}  	 
	}          
}
void LCDShowHZList(uint8_t x,uint8_t y,uint8_t hro,uint8_t size,uint8_t mode,uint8_t num)
{
	uint8_t i;
	
	for(i=0;i<num;i++)
	{
		LCD_Showhz(x,y,hro,size,mode);
		if(x>100)
		
		{
			x = 0;
			y =y +(size+2);
		}
		
		x = x+(size+2);
		hro++;
	}
}

//显示卡机画面(公司logo+广告词)
void LCDShowLogo(void)
{
	static uint8_t st=0;
	
	if(0 == st)
	{
		st = 1;
		Dly_Var.gIdeFlashSpd = 500;
		LCD_Clear();
		Display_pic(0,10,131,48,1);
		LCD_ShowString(60,66,"Ver_ .  ");
		LCD_ShowNum(88,66,Config.DxSwVer,2,12);
		LCD_ShowNum(104,66,Config.DxHwVer,2,12);	
	}
	if(1 == st)
	{
			if(0 == Dly_Var.gIdeFlashSpd)
			{
				st = 2;
				Dly_Var.gIdeFlashSpd = 500;
				LCD_Clear();
				LCDShowHZList(0,20,0,16,1,13);
		}					
	}
	if(st == 2)
	{
		if(0 == Dly_Var.gIdeFlashSpd)
		{
			st =3;
			SysVar.DisType = IDE_MOD;
			Dly_Var.LCDIdeT = (Config.PromptTim*100);
		}
	}
}

void Draw_eye(uint8_t x0,uint8_t y0,uint8_t r)
{
	int a,b;
	int di;
	a=0;b=r;	  
	di=3-(r<<1);             //判断下个点位置的标志
	while(a<=b)
	{
		DisplayOneEye(x0+a,y0-b,16,16,1);
		DisplayOneEye(x0+b,y0-a,16,16,1);
		DisplayOneEye(x0+a,y0+b,16,16,1);
		DisplayOneEye(x0+a,y0+b,16,16,1);
		DisplayOneEye(x0-a,y0+b,16,16,1);
		DisplayOneEye(x0-b,y0+a,16,16,1);
		DisplayOneEye(x0-b,y0-a,16,16,1);
		a++;
		//使用Bresenham算法画圆     
		if(di<0)di +=4*a+6;	  
		else
		{
			di+=10+4*(a-b);   
			b--;
		} 						    
	}
} 									  

/*
*显示待机动画
*/
void LCDShowIdeFlash(void)
{
		if(0 == Dly_Var.gIdeFlashSpd)
		{
			Dly_Var.gIdeFlashSpd = 800;
			LCD_Clear();
			Displayxiaoji(4,6,67,72,1);
		}
		if((Dly_Var.gIdeFlashSpd <= 750)&&(Dly_Var.gIdeFlashSpd > 700))
		{
 			DisplayOneEye(48,10,16,16,1);
 			DisplayOneEye(12,14,16,16,1);
		}
		if((Dly_Var.gIdeFlashSpd <= 700)&&(Dly_Var.gIdeFlashSpd > 650))
		{
 			DisplayOneEye(48,10,16,16,0);
 			DisplayOneEye(12,14,16,16,0);
		}
		if((Dly_Var.gIdeFlashSpd <= 650)&&(Dly_Var.gIdeFlashSpd > 600))
		{
 			DisplayOneEye(48,10,16,16,1);
 			DisplayOneEye(12,14,16,16,1);
		}
		
		if((Dly_Var.gIdeFlashSpd <= 600)&&(Dly_Var.gIdeFlashSpd > 550))
		{
			Draw_Circle(80,35,5);
		}
		if((Dly_Var.gIdeFlashSpd <= 550)&&(Dly_Var.gIdeFlashSpd > 500))
		{
			Draw_Circle(90,20,8);
		}
 		if((Dly_Var.gIdeFlashSpd <= 500)&&(Dly_Var.gIdeFlashSpd > 450))
		{	
 			LCDShowHZList(106,6,50,16,1,1);
 		}
 		if((Dly_Var.gIdeFlashSpd <= 450)&&(Dly_Var.gIdeFlashSpd > 400))
		{	
 			LCDShowHZList(106,24,51,16,1,1);
 		}
 		if((Dly_Var.gIdeFlashSpd <= 400)&&(Dly_Var.gIdeFlashSpd > 350))
		{		
 			LCDShowHZList(106,42,52,16,1,1);
 		}		
}

/*
*显示刷卡成功，扣费金额，余额信息界面
*/
void LCDShowICInfo(void)
{
	LCD_Clear();
	LCDShowHZList(2,20,13,16,1,6);
	LCDShowHZList(2,40,19,16,1,6);
	switch(Config.Price)
	{
		case 0:
			break;
		case BI:
			LCDShowHZList(109,40,68,16,1,1);
			LCDShowHZList(109,20,68,16,1,1);
			break;
		case YUAN:
			LCDShowHZList(109,40,69,16,1,1);
			LCDShowHZList(109,20,69,16,1,1);
			break;
		default:
			break;
	}
	
	
	LCD_ShowChar(89,44,'.',12,1);
	LCD_ShowChar(89,24,'.',12,1);
	LCD_ShowxNum(45,40,(uint32_t)SysVar.ye/100,5,16,DIS_NORMAL);
	LCD_ShowxNum(93,40,(uint32_t)SysVar.ye%100,2,16,DIS_NORMAL|NUM_FILL_0);
	LCD_ShowxNum(45,20,(uint32_t)SysVar.xf/100,5,16,DIS_NORMAL);
	LCD_ShowxNum(93,20,(uint32_t)SysVar.xf%100,2,16,DIS_NORMAL|NUM_FILL_0);
}

/*
*显示刷卡成功，余额不足信息
*/
void LCDShowNoMonyInfo(void)
{
	LCD_Clear();
	LCDShowHZList(24,20,29,16,1,4);
	LCDShowHZList(2,45,19,16,1,3);
	LCD_ShowChar(89,49,'.',12,1);
	LCD_ShowxNum(50,45,SysVar.ye/100,5,16,DIS_NORMAL);
	LCD_ShowxNum(93,45,SysVar.ye%100,2,16,DIS_NORMAL|NUM_FILL_0);
	switch(Config.Price)
	{
		case 0:
			break;
		case BI:
			LCDShowHZList(109,45,68,16,1,1);
			break;
		case YUAN:
			LCDShowHZList(109,45,69,16,1,1);
			break;
		default:
			break;
	}
}
/*
*显示刷卡器故障，请联系管理员
*/
void LCDShowReaderErr(void)
{
	LCD_Clear();
	LCDShowHZList(18,20,53,16,1,5);
	LCDShowHZList(8,40,58,16,1,6);
}
/*
*显示刷卡失败
*/
void LCDShowReaderFailed(void)
{
	LCD_Clear();
	LCDShowHZList(25,30,64,16,1,4);
}
/*
*显示卡片过期
*/
void LCDShowICOverTim(void)
{
	LCD_Clear();
	LCDShowHZList(25,30,74,16,1,4);
}
/*
*显示卡片挂失
*/
void LCDShowICLoss(void)
{
	LCD_Clear();
	LCDShowHZList(25,30,70,16,1,4);
}
/*
*显示非法卡信息
*/
void LCDShowInvalidICInfo(void)
{
	LCD_Clear();
	LCDShowHZList(40,30,34,16,1,4);
}

/*
*显示连接中断
*/
void LCDShowNoLnkInfo(void)
{
	LCD_Clear();
	LCDShowHZList(30,30,38,16,1,5);
}
/*
*显示连接中断
*/
void LCDShowNo2_4gInfo(void)
{
	LCD_Clear();
	LCDShowHZList(8,30,43,16,1,7);
	LCDRefresh_Gram();
}



void LCDInit(void)
{	
	Init_ST7588();
//	LCDShowLogo();
	LCD_Clear();
}


void LCDDisplayTask(void)
{	
		static uint8_t tyo,tyn;
		tyo = tyn;
		tyn = SysVar.DisType;
		if(tyn != tyo)
		{
			//	LCD_Clear();
				Dly_Var.gIdeFlashSpd =0;
				Dly_Var.LCDIdeT = (Config.PromptTim*100);
		}
		else if(Dly_Var.LCDIdeT == 0)
		{
			SysVar.DisType = IDE_MOD;
		}
		switch(SysVar.DisType)
		{
				case IDE_MOD:
					LCDShowIdeFlash();
					LCD_ShowString(70,66,"ID:  ");
					LCD_ShowNum(90,66,Config.DxID,5,12);
					LCD_ShowString(70,55,"FQ:  ");
					LCD_ShowNum(90,55,Config.DxFQ,3,12);
					LCD_ShowString(2,66,"v . ");
					LCD_ShowNum(10,66,(Config.DxSwVer/10),1,12);
					LCD_ShowNum(22,66,(Config.DxSwVer%10),1,12);
					break;
				case ERR_MOD:
					LCDShowInvalidICInfo();
					break;
				case NOLNK_MOD:
					LCDShowNoLnkInfo();
					break;
				case ICINFO_MOD:
					LCDShowICInfo();
					break;
				case NOMON_MOD:
					LCDShowNoMonyInfo();
					break;
				case ERR_PROMPT:
					LCDShowReaderErr();
					break;
				case UNKNOW_ERR:
					LCDShowReaderFailed();
					break;
				case ERR_LOSS_DIS:
					LCDShowICLoss();
					break;
				case ERR_OVER_DIS:
					LCDShowICOverTim();
					break;
				default:
					break;
		}		
		LCDRefresh_Gram();	
}



